## config/boards/shields/jorne/Kconfig.shield
```kconfig
# Jorne shields

config SHIELD_JORNE_LEFT
    bool "Jorne left shield"

config SHIELD_JORNE_RIGHT
    bool "Jorne right shield"

config SHIELD_JORNE_DONGLE
    bool "Jorne dongle shield"
```

## config/boards/shields/jorne_dongle/Kconfig.defconfig
```kconfig
if SHIELD_JORNE_DONGLE

config ZMK_KEYBOARD_NAME
    default "Jorne Dongle"

endif
```

## config/west.yml
```yaml
manifest:
  remotes:
  - name: zmkfirmware
    url-base: https://github.com/zmkfirmware
  projects:
  - name: zmk
    remote: zmkfirmware
    revision: main
    import: app/west.yml
  - name: zmk-studio-helper
    remote: zmkfirmware
    revision: main
    path: optional/modules/zmk-studio-helper
  self:
    path: config
```
